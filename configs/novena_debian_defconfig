## configs/novena_debian_defconfig
```kconfig
BR2_arm=y
BR2_cortex_a9=y
BR2_ARM_ENABLE_NEON=y
BR2_DEFCONFIG="$(CONFIG_DIR)/defconfig"
BR2_CCACHE=y
BR2_TOOLCHAIN_EXTERNAL=y
BR2_TARGET_GENERIC_HOSTNAME="novena"
BR2_TARGET_GENERIC_PASSWD_SHA512=y
BR2_INIT_NONE=y
BR2_TARGET_GENERIC_GETTY_PORT="ttymxc1"
BR2_ROOTFS_POST_BUILD_SCRIPT="board/kosagi/novena/uboot-mkimage.sh"
BR2_ROOTFS_POST_IMAGE_SCRIPT="board/kosagi/novena/novena_make_debian_rootfs_ext4.sh board/kosagi/novena/novena_make_rom.sh board/kosagi/novena/novena_make_debian_rom.sh"
# BR2_PACKAGE_BUSYBOX is not set
BR2_PACKAGE_HOST_UBOOT_TOOLS=y
BR2_PACKAGE_HOST_MAKEDISK=y
BR2_PACKAGE_HOST_GENFATFS=y
BR2_TARGET_ROOTFS_EXT2=y
BR2_TARGET_ROOTFS_EXT2_4=y
BR2_TARGET_ROOTFS_EXT2_BLOCKS=1000000
BR2_TARGET_ROOTFS_EXT2_INODES=50000
BR2_TARGET_ROOTFS_EXT2_RESBLKS=50
# BR2_TARGET_ROOTFS_TAR is not set
BR2_TARGET_UBOOT=y
BR2_TARGET_UBOOT_BOARDNAME="novena"
BR2_TARGET_UBOOT_CUSTOM_GIT=y
BR2_TARGET_UBOOT_CUSTOM_GIT_REPO_URL="https://github.com/sutajiokousagi/u-boot-imx6.git"
BR2_TARGET_UBOOT_CUSTOM_GIT_VERSION="8b44e8bbbb9d6d3366ab1fb390bbe91a7eb719fa"
BR2_TARGET_UBOOT_CUSTOM_GIT_LOCALVERSION="-00052-g8b44e8b"
BR2_TARGET_UBOOT_FORMAT_IMX=y
BR2_LINUX_KERNEL=y
BR2_LINUX_KERNEL_CUSTOM_GIT=y
BR2_LINUX_KERNEL_CUSTOM_GIT_REPO_URL="https://github.com/sutajiokousagi/linux.git"
BR2_LINUX_KERNEL_CUSTOM_GIT_VERSION="novena"
BR2_LINUX_KERNEL_USE_CUSTOM_CONFIG=y
BR2_LINUX_KERNEL_CUSTOM_CONFIG_FILE="board/kosagi/novena/linux-3.10.config"
BR2_LINUX_KERNEL_UIMAGE_LOADADDR="10008000"
BR2_LINUX_KERNEL_DTS_SUPPORT=y
BR2_LINUX_KERNEL_USE_CUSTOM_DTS=y
BR2_LINUX_KERNEL_CUSTOM_DTS_PATH="board/kosagi/novena/imx6q-novena.dts"
```

## package/genfatfs/Config.in.host
```kconfig
config BR2_PACKAGE_HOST_GENFATFS
	bool "host genfatfs"
	help
	  FAT filesystem disk image generator.

	  https://github.com/xobs/genfatfs
```

## package/makedisk/Config.in.host
```kconfig
config BR2_PACKAGE_HOST_MAKEDISK
	bool "host makedisk"
	help
	  SD Card image generator (multi-partition)

	  https://github.com/sutajiokousagi/makedisk
```
